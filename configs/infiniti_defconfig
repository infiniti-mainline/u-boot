## configs/infiniti_defconfig
```kconfig
#include "qcom_defconfig"
# CONFIG_OF_UPSTREAM is not set
# CONFIG_EFI_RUNTIME_UPDATE_CAPSULE is not set
# CONFIG_EFI_CAPSULE_ON_DISK is not set
CONFIG_DEFAULT_DEVICE_TREE="kaanapali-oneplus-infiniti"
CONFIG_ENV_DEFAULT_ENV_TEXT_FILE="board/qualcomm/infiniti.env"
CONFIG_ENV_RELOC_GD_ENV_ADDR=y
CONFIG_LNX_KRNL_IMG_TEXT_OFFSET_BASE=0x0
CONFIG_PHY_QCOM_M31_EUSB2=y
# CONFIG_QCOM_RPMH_POWER_DOMAIN is not set
CONFIG_USB_FUNCTION_FASTBOOT=y
CONFIG_FASTBOOT_BUF_ADDR=0xc6000000
CONFIG_FASTBOOT_BUF_SIZE=0x10000000
CONFIG_VIDEO=y
CONFIG_VIDEO_SIMPLE=y
# CONFIG_VIDEO_FONT_8X16 is not set
CONFIG_VIDEO_FONT_16X32=y
# CONFIG_REQUIRE_SERIAL_CONSOLE is not set
CONFIG_BUTTON_GPIO=y
CONFIG_BUTTON_REMAP_PHONE_KEYS=y
CONFIG_BLKMAP=y
# CONFIG_FAT_WRITE is not set
# CONFIG_EXT4_WRITE is not set
CONFIG_EFI_VARIABLE_NO_STORE=y
```
